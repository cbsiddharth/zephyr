## drivers/osdp/Kconfig
```kconfig
#
# Copyright (c) 2020 Siddharth Chandrasekaran <siddharth@embedjournal.com>
#
# SPDX-License-Identifier: Apache-2.0
#

menuconfig OSDP
	bool "Open Supervised Device Protocol (OSDP) driver"
	select RING_BUFFER
	select SERIAL
	select SERIAL_HAS_DRIVER
	select SERIAL_SUPPORT_INTERRUPT
	select UART_INTERRUPT_DRIVEN
	select ENTROPY_GENERATOR
	select TEST_RANDOM_GENERATOR
	help
	  Add support for Open Supervised Device Protocol (OSDP)

if OSDP

config OSDP_UART_DEV_NAME
	string "Device mame of UART device for OSDP"
	default "UART_2"
	help
	  This option specifies the name of UART device to be used for
	  OSDP

config OSDP_UART_BAUD_RATE
	int "OSDP UART baud rate"
	default 115200
	help
	  OSDP defines that baud rate can be either 9600 or 38400 or
	  115200.

config OSDP_UART_BUFFER_LENGTH
	int "OSDP UART buffer lenght"
	default 512
	help
	  OSDP RX and TX buffer FIFO length.

config OSDP_CRYPTO_DRV_NAME
	string "Crypto driver to use with OSDP"
	default "CRYPTO_MTLS"
	help
	  OSDP Secure Channel uses AES-128 to secure communication between
	  CP and PD. Provide an available crypto driver name here.

config OSDP_LOG_LEVEL
	int "OSDP Logging Level"
	default 1
	help
	  Set the logging level for the OSDP driver

config OSDP_THREAD_STACK_SIZE
	int "OSDP Thread stack size"
	default 2048
	help
	  Thread stack size for osdp refresh thread

config OSDP_PACKET_TRACE
	bool "Print bytes sent/received over OSDP to console"
	help
	  Prints bytes sent/received over OSDP to console for debugging.
	  LOG_HEXDUMP_DBG() is used to achive this and can be very verbose and
	  pollute the log.

choice
	prompt "OSDP Mode of Operation"
	default OSDP_MODE_PD
	config OSDP_MODE_CP
		bool "Configure OSDP in CP mode"
		help
		  Configure this device to operate as a Control Pannel
	config OSDP_MODE_PD
		bool "Configure OSDP in PD mode"
		help
		  Configure this device to operate as a Peripheral Device
endchoice

if OSDP_MODE_PD
source "drivers/osdp/Kconfig.pd"
endif

endif # OSDP
```
